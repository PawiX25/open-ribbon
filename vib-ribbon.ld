SECTIONS
{
    __romPos = 0;
    _gp = 0x80047EB8;
    header_ROM_START = __romPos;
    header_VRAM = ADDR(.header);
    .header : AT(header_ROM_START) SUBALIGN(16)
    {
        FILL(0x00000000);
        header_DATA_START = .;
        header_s = .;
        build/asm/game/header.s.o(.data);
        header_DATA_END = .;
        header_DATA_SIZE = ABSOLUTE(header_DATA_END - header_DATA_START);
    }
    __romPos += SIZEOF(.header);
    header_ROM_END = __romPos;
    header_VRAM_END = .;

    vib_ribbon_ROM_START = __romPos;
    vib_ribbon_VRAM = ADDR(.vib_ribbon);
    .vib_ribbon 0x80019000 : AT(vib_ribbon_ROM_START) SUBALIGN(4)
    {
        FILL(0x00000000);
        vib_ribbon_RODATA_START = .;
        build/src/game/VideoSys.c.o(.rodata);
        build/src/game/CdSys.cpp.o(.rodata);
        build/src/game/AudioSys.c.o(.rodata);
        build/src/game/InputSys.c.o(.rodata);
        build/asm/game/data/A44.rodata.s.o(.rodata);
        build/asm/game/data/C00.rodata.s.o(.rodata);
        build/asm/game/data/EA4.rodata.s.o(.rodata);
        build/asm/game/data/F74.rodata.s.o(.rodata);
        build/asm/game/data/1070.rodata.s.o(.rodata);
        build/asm/game/data/1810.rodata.s.o(.rodata);
        build/asm/game/data/3F5C.rodata.s.o(.rodata);
        build/asm/game/data/4264.rodata.s.o(.rodata);
        build/asm/game/data/42A4.rodata.s.o(.rodata);
        build/asm/game/data/42E4.rodata.s.o(.rodata);
        build/asm/game/data/4304.rodata.s.o(.rodata);
        build/asm/game/data/432C.rodata.s.o(.rodata);
        build/asm/game/data/43E4.rodata.s.o(.rodata);
        build/asm/game/data/4604.rodata.s.o(.rodata);
        build/asm/game/data/4634.rodata.s.o(.rodata);
        build/asm/game/data/4664.rodata.s.o(.rodata);
        build/asm/game/data/46F4.rodata.s.o(.rodata);
        build/asm/game/data/4948.rodata.s.o(.rodata);
        build/asm/game/data/49B0.rodata.s.o(.rodata);
        build/asm/game/data/4C44.rodata.s.o(.rodata);
        build/asm/game/data/4C60.rodata.s.o(.rodata);
        . = ALIGN(., 4);
        vib_ribbon_RODATA_END = .;
        vib_ribbon_RODATA_SIZE = ABSOLUTE(vib_ribbon_RODATA_END - vib_ribbon_RODATA_START);
        vib_ribbon_TEXT_START = .;
        build/src/game/VideoSys.c.o(.text);
        build/src/game/FontHack.cpp.o(.text);
        build/src/game/CdSys.cpp.o(.text);
        build/src/game/AudioSys.c.o(.text);
        build/src/game/InputSys.c.o(.text);
        build/src/game/MemorySys.cpp.o(.text);
        build/src/game/E9A0.cpp.o(.text);
        build/src/game/F2DC.cpp.o(.text);
        build/src/game/12250.cpp.o(.text);
        build/asm/game/entrypoint.s.o(.text);
        build/asm/game/psyq.s.o(.text);
        build/asm/game/13F18.s.o(.text);
        build/asm/game/14348.s.o(.text);
        build/asm/game/14428.s.o(.text);
        build/asm/game/144A8.s.o(.text);
        build/src/game/19648.cpp.o(.text);
        build/asm/game/19958.s.o(.text);
        build/asm/game/19CD8.s.o(.text);
        build/asm/game/1A144.s.o(.text);
        build/asm/game/1A1A4.s.o(.text);
        build/asm/game/1A204.s.o(.text);
        build/asm/game/1A2E4.s.o(.text);
        build/asm/game/1A4A4.s.o(.text);
        build/asm/game/1A774.s.o(.text);
        build/asm/game/1A834.s.o(.text);
        build/asm/game/1A8B4.s.o(.text);
        build/asm/game/1A984.s.o(.text);
        build/asm/game/1AA04.s.o(.text);
        build/asm/game/1AB30.s.o(.text);
        build/asm/game/1B130.s.o(.text);
        build/asm/game/1B790.s.o(.text);
        build/asm/game/1B9FC.s.o(.text);
        build/asm/game/1BA4C.s.o(.text);
        build/asm/game/1BA8C.s.o(.text);
        build/asm/game/1BCEC.s.o(.text);
        build/asm/game/1CB0C.s.o(.text);
        build/asm/game/1D4AC.s.o(.text);
        build/asm/game/1D5FC.s.o(.text);
        build/asm/game/1D8AC.s.o(.text);
        build/asm/game/1D90C.s.o(.text);
        build/asm/game/1D97C.s.o(.text);
        build/asm/game/1D998.s.o(.text);
        build/asm/game/1D9C8.s.o(.text);
        build/asm/game/1E854.s.o(.text);
        build/asm/game/1EBBC.s.o(.text);
        build/asm/game/1EBDC.s.o(.text);
        build/asm/game/1EBEC.s.o(.text);
        build/asm/game/1EBFC.s.o(.text);
        build/asm/game/1EC1C.s.o(.text);
        build/asm/game/1ECDC.s.o(.text);
        build/asm/game/1ED8C.s.o(.text);
        build/asm/game/1EDFC.s.o(.text);
        build/asm/game/1EE9C.s.o(.text);
        build/asm/game/1EFAC.s.o(.text);
        build/asm/game/1EFBC.s.o(.text);
        build/asm/game/1F02C.s.o(.text);
        build/asm/game/1F11C.s.o(.text);
        build/asm/game/1F1BC.s.o(.text);
        build/asm/game/1F1DC.s.o(.text);
        build/asm/game/1F20C.s.o(.text);
        build/asm/game/1F22C.s.o(.text);
        build/asm/game/1F24C.s.o(.text);
        build/asm/game/1F28C.s.o(.text);
        build/asm/game/1F2DC.s.o(.text);
        build/asm/game/1F35C.s.o(.text);
        build/asm/game/1F42C.s.o(.text);
        build/asm/game/1FAF0.s.o(.text);
        build/asm/game/1FBB0.s.o(.text);
        build/asm/game/1FC10.s.o(.text);
        build/asm/game/20D9C.s.o(.text);
        build/asm/game/21794.s.o(.text);
        build/asm/game/22CC8.s.o(.text);
        build/asm/game/22E28.s.o(.text);
        build/asm/game/23138.s.o(.text);
        build/asm/game/23168.s.o(.text);
        build/asm/game/23178.s.o(.text);
        build/asm/game/23188.s.o(.text);
        build/asm/game/23EFC.s.o(.text);
        build/asm/game/243BC.s.o(.text);
        build/asm/game/24FD0.s.o(.text);
        build/asm/game/2617C.s.o(.text);
        build/asm/game/2620C.s.o(.text);
        build/asm/game/264CC.s.o(.text);
        build/asm/game/2651C.s.o(.text);
        build/asm/game/2653C.s.o(.text);
        build/asm/game/2655C.s.o(.text);
        build/asm/game/2659C.s.o(.text);
        build/asm/game/2662C.s.o(.text);
        build/asm/game/2665C.s.o(.text);
        build/asm/game/2666C.s.o(.text);
        build/asm/game/26ED4.s.o(.text);
        build/asm/game/26FA4.s.o(.text);
        build/asm/game/27084.s.o(.text);
        . = ALIGN(., 4);
        vib_ribbon_TEXT_END = .;
        vib_ribbon_TEXT_SIZE = ABSOLUTE(vib_ribbon_TEXT_END - vib_ribbon_TEXT_START);
        vib_ribbon_DATA_START = .;
        _27118_data__s = .;
        build/asm/game/data/27118.data.s.o(.data);
        build/src/game/VideoSys.c.o(.sdata);
        FontHack_c = .;
        build/src/game/FontHack.cpp.o(.data);
        VideoSys_data__s = .;
        build/asm/game/data/VideoSys.data.s.o(.data);
        build/src/game/VideoSys.c.o(.sbss);
        build/src/game/CdSys.cpp.o(.sdata);
        build/src/game/AudioSys.c.o(.sdata);
        _2F7A0_data__s = .;
        build/asm/game/data/2F7A0.data.s.o(.data);
        _2F964_data__s = .;
        build/asm/game/data/2F964.data.s.o(.data);
        _2F970_data__s = .;
        build/asm/game/data/2F970.data.s.o(.data);
        . = ALIGN(., 4);
        vib_ribbon_DATA_END = .;
        vib_ribbon_DATA_SIZE = ABSOLUTE(vib_ribbon_DATA_END - vib_ribbon_DATA_START);
    }
    vib_ribbon_bss_VRAM = ADDR(.vib_ribbon_bss);
    .vib_ribbon_bss (NOLOAD) : SUBALIGN(4)
    {
        FILL(0x00000000);
        vib_ribbon_BSS_START = .;
        build/src/game/VideoSys.c.o(.bss);
        build/src/game/CdSys.cpp.o(.bss);
        build/src/game/AudioSys.c.o(.bss);
        build/src/game/InputSys.c.o(.bss);
        build/asm/game/data/A44.rodata.s.o(.bss);
        build/asm/game/data/C00.rodata.s.o(.bss);
        build/asm/game/data/EA4.rodata.s.o(.bss);
        build/asm/game/data/F74.rodata.s.o(.bss);
        build/asm/game/data/1070.rodata.s.o(.bss);
        build/asm/game/data/1810.rodata.s.o(.bss);
        build/asm/game/data/3F5C.rodata.s.o(.bss);
        build/asm/game/data/4264.rodata.s.o(.bss);
        build/asm/game/data/42A4.rodata.s.o(.bss);
        build/asm/game/data/42E4.rodata.s.o(.bss);
        build/asm/game/data/4304.rodata.s.o(.bss);
        build/asm/game/data/432C.rodata.s.o(.bss);
        build/asm/game/data/43E4.rodata.s.o(.bss);
        build/asm/game/data/4604.rodata.s.o(.bss);
        build/asm/game/data/4634.rodata.s.o(.bss);
        build/asm/game/data/4664.rodata.s.o(.bss);
        build/asm/game/data/46F4.rodata.s.o(.bss);
        build/asm/game/data/4948.rodata.s.o(.bss);
        build/asm/game/data/49B0.rodata.s.o(.bss);
        build/asm/game/data/4C44.rodata.s.o(.bss);
        build/asm/game/data/4C60.rodata.s.o(.bss);
        build/src/game/FontHack.cpp.o(.bss);
        build/src/game/MemorySys.cpp.o(.bss);
        build/src/game/E9A0.cpp.o(.bss);
        build/src/game/F2DC.cpp.o(.bss);
        build/src/game/12250.cpp.o(.bss);
        build/asm/game/entrypoint.s.o(.bss);
        build/asm/game/psyq.s.o(.bss);
        build/asm/game/13F18.s.o(.bss);
        build/asm/game/14348.s.o(.bss);
        build/asm/game/14428.s.o(.bss);
        build/asm/game/144A8.s.o(.bss);
        build/src/game/19648.cpp.o(.bss);
        build/asm/game/19958.s.o(.bss);
        build/asm/game/19CD8.s.o(.bss);
        build/asm/game/1A144.s.o(.bss);
        build/asm/game/1A1A4.s.o(.bss);
        build/asm/game/1A204.s.o(.bss);
        build/asm/game/1A2E4.s.o(.bss);
        build/asm/game/1A4A4.s.o(.bss);
        build/asm/game/1A774.s.o(.bss);
        build/asm/game/1A834.s.o(.bss);
        build/asm/game/1A8B4.s.o(.bss);
        build/asm/game/1A984.s.o(.bss);
        build/asm/game/1AA04.s.o(.bss);
        build/asm/game/1AB30.s.o(.bss);
        build/asm/game/1B130.s.o(.bss);
        build/asm/game/1B790.s.o(.bss);
        build/asm/game/1B9FC.s.o(.bss);
        build/asm/game/1BA4C.s.o(.bss);
        build/asm/game/1BA8C.s.o(.bss);
        build/asm/game/1BCEC.s.o(.bss);
        build/asm/game/1CB0C.s.o(.bss);
        build/asm/game/1D4AC.s.o(.bss);
        build/asm/game/1D5FC.s.o(.bss);
        build/asm/game/1D8AC.s.o(.bss);
        build/asm/game/1D90C.s.o(.bss);
        build/asm/game/1D97C.s.o(.bss);
        build/asm/game/1D998.s.o(.bss);
        build/asm/game/1D9C8.s.o(.bss);
        build/asm/game/1E854.s.o(.bss);
        build/asm/game/1EBBC.s.o(.bss);
        build/asm/game/1EBDC.s.o(.bss);
        build/asm/game/1EBEC.s.o(.bss);
        build/asm/game/1EBFC.s.o(.bss);
        build/asm/game/1EC1C.s.o(.bss);
        build/asm/game/1ECDC.s.o(.bss);
        build/asm/game/1ED8C.s.o(.bss);
        build/asm/game/1EDFC.s.o(.bss);
        build/asm/game/1EE9C.s.o(.bss);
        build/asm/game/1EFAC.s.o(.bss);
        build/asm/game/1EFBC.s.o(.bss);
        build/asm/game/1F02C.s.o(.bss);
        build/asm/game/1F11C.s.o(.bss);
        build/asm/game/1F1BC.s.o(.bss);
        build/asm/game/1F1DC.s.o(.bss);
        build/asm/game/1F20C.s.o(.bss);
        build/asm/game/1F22C.s.o(.bss);
        build/asm/game/1F24C.s.o(.bss);
        build/asm/game/1F28C.s.o(.bss);
        build/asm/game/1F2DC.s.o(.bss);
        build/asm/game/1F35C.s.o(.bss);
        build/asm/game/1F42C.s.o(.bss);
        build/asm/game/1FAF0.s.o(.bss);
        build/asm/game/1FBB0.s.o(.bss);
        build/asm/game/1FC10.s.o(.bss);
        build/asm/game/20D9C.s.o(.bss);
        build/asm/game/21794.s.o(.bss);
        build/asm/game/22CC8.s.o(.bss);
        build/asm/game/22E28.s.o(.bss);
        build/asm/game/23138.s.o(.bss);
        build/asm/game/23168.s.o(.bss);
        build/asm/game/23178.s.o(.bss);
        build/asm/game/23188.s.o(.bss);
        build/asm/game/23EFC.s.o(.bss);
        build/asm/game/243BC.s.o(.bss);
        build/asm/game/24FD0.s.o(.bss);
        build/asm/game/2617C.s.o(.bss);
        build/asm/game/2620C.s.o(.bss);
        build/asm/game/264CC.s.o(.bss);
        build/asm/game/2651C.s.o(.bss);
        build/asm/game/2653C.s.o(.bss);
        build/asm/game/2655C.s.o(.bss);
        build/asm/game/2659C.s.o(.bss);
        build/asm/game/2662C.s.o(.bss);
        build/asm/game/2665C.s.o(.bss);
        build/asm/game/2666C.s.o(.bss);
        build/asm/game/26ED4.s.o(.bss);
        build/asm/game/26FA4.s.o(.bss);
        build/asm/game/27084.s.o(.bss);
        . = ALIGN(., 4);
        vib_ribbon_BSS_END = .;
        vib_ribbon_BSS_SIZE = ABSOLUTE(vib_ribbon_BSS_END - vib_ribbon_BSS_START);
    }
    __romPos += SIZEOF(.vib_ribbon);
    __romPos = ALIGN(__romPos, 4);
    . = ALIGN(., 4);
    vib_ribbon_ROM_END = __romPos;
    vib_ribbon_VRAM_END = .;

    /DISCARD/ :
    {
        *(*);
    }
}
